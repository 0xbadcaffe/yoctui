## artifacts/live-xilinx/zcu102/validation-layer/conf/layer.conf
```bitbake
BBPATH .= ":${LAYERDIR}"
BBFILES += "${LAYERDIR}/recipes-*/*/*.bbappend"
BBFILE_COLLECTIONS += "yoctui_zcu102_validation"
BBFILE_PATTERN_yoctui_zcu102_validation = "^${LAYERDIR}/"
BBFILE_PRIORITY_yoctui_zcu102_validation = "99"
LAYERSERIES_COMPAT_yoctui_zcu102_validation = "scarthgap"
LAYERDEPENDS_yoctui_zcu102_validation = "core"
```
